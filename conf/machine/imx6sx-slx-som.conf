## conf/machine/imx8mp-navqp.conf
```bitbake
#@TYPE: Machine
#@NAME: Emcraft Systems i.MX8MP 2GB LPDDR4 SOM
#@SOC: i.MX8MP
#@DESCRIPTION: Machine configuration for Emcraft Systems i.MX8MP 2GB LPDDR4 SOM
#@MAINTAINER: Emcraft Systems <customer-service@emcraft.com>

MACHINE="imx8mp-navqp"

MACHINEOVERRIDES =. "mx8:mx8m:mx8mp:"

IMX_DEFAULT_BSP = "nxp"
IMX_DEFAULT_BSP:upstream = "mainline"

require conf/machine/include/imx-base.inc
# override imx-base.inc which sets this to cortexa53-crypto
DEFAULTTUNE:mx8mp-generic-bsp = "armv8a-crypto"
require conf/machine/include/arm/armv8a/tune-cortexa53.inc

# Don't include kernels in standard images
RRECOMMENDS:${KERNEL_PACKAGE_NAME}-base = ""

MACHINE_FEATURES += " pci wifi bluetooth bcm43455"

PREFERRED_PROVIDER_virtual/kernel = "linux-imx-emcraft"

KBUILD_DEFCONFIG:mx8-generic-bsp = "imx_v8_defconfig"

IMX_DEFAULT_BOOTLOADER = "u-boot-imx"

KERNEL_DEVICETREE_BASENAME = "imx8mp-navq"
KERNEL_DEVICETREE = "freescale/${KERNEL_DEVICETREE_BASENAME}.dtb"

UBOOT_CONFIG ??= "sd"
UBOOT_CONFIG_BASENAME = "navqp"
UBOOT_CONFIG[fspi]    = "${UBOOT_CONFIG_BASENAME}_defconfig"
UBOOT_CONFIG[sd]      = "${UBOOT_CONFIG_BASENAME}_defconfig,sdcard"
UBOOT_CONFIG[ecc]     = "${UBOOT_CONFIG_BASENAME}_inline_ecc_defconfig"
UBOOT_CONFIG[mfgtool] = "${UBOOT_CONFIG_BASENAME}_defconfig"

OSTREE_KERNEL_ARGS:imx8mp-navqp = "earlyprintk earlycon console=ttymxc1,115200"

SPL_BINARY = "spl/u-boot-spl.bin"
IMX_BOOT_SOC_TARGET = "iMX8MP"

PREFERRED_PROVIDER_u-boot-default-script = "u-boot-distro-boot"

# Set DDR FIRMWARE
DDR_FIRMWARE_VERSION = "202006"
DDR_FIRMWARE_NAME = " \
	lpddr4_pmu_train_1d_dmem_${DDR_FIRMWARE_VERSION}.bin \
	lpddr4_pmu_train_1d_imem_${DDR_FIRMWARE_VERSION}.bin \
	lpddr4_pmu_train_2d_dmem_${DDR_FIRMWARE_VERSION}.bin \
	lpddr4_pmu_train_2d_imem_${DDR_FIRMWARE_VERSION}.bin \
"

ATF_PLATFORM = "imx8mp"

# Set u-boot DTB
UBOOT_DTB_NAME = "navqp.dtb"

# Set imx-mkimage boot target
IMXBOOT_TARGETS = "flash_evk"

# Set Serial console
SERIAL_CONSOLES = "115200;ttymxc1"

IMAGE_BOOTLOADER = "imx-boot"

LOADADDR = ""
UBOOT_SUFFIX = "bin"
UBOOT_MAKE_TARGET = ""
IMX_BOOT_SEEK = "32"

OPTEE_BIN_EXT = "8mp"

IMXBOOT_TARGETS_BASENAME = "flash_evk"

CORE_IMAGE_BASE_INSTALL:remove = " \
    kernel-module-isp-vvcam \
"
RDEPENDS:initramfs-module-kmod:remove:mx8-nxp-bsp = " \
    kernel-module-sec-dsim \
    kernel-module-sec-mipi-dsim-imx \
    kernel-module-ti-sn65dsi83 \
"

TEZI_ROOT_SUFFIX:imx8mp-navqp = "ota-ext4"
```
